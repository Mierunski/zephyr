## drivers/simple_led/Kconfig
```kconfig
# Kconfig - SIMPLE_LED configuration options

#
# Copyright (c) 2019, Nordic Semiconductor ASA
#
# SPDX-License-Identifier: Apache-2.0
#

#
# SIMPLE_LED options
#
menuconfig SIMPLE_LED
	bool "Simple led Drivers"
	help
	  Enable Simple Led Driver Configuration

if SIMPLE_LED

# Include these first so that any properties (e.g. defaults) below can be
# overriden (by defining symbols in multiple locations)
source "drivers/simple_led/Kconfig.nrfx"


config SIMPLE_LED_INIT_PRIORITY
	int "Init priority"
	default 60
	help
	  SIMPLE_LED device driver initialization priority.


module = SIMPLE_LED
module-str = SIMPLE_LED
source "subsys/logging/Kconfig.template.log_config"

config SIMPLE_LED_0
	bool "Enable SIMPLE_LED Port 0"

endif # SIMPLE_LED
```

## drivers/simple_led/Kconfig.nrfx
```kconfig
# Kconfig -Simple Led support
#
# Copyright (c) 2019, Nordic Semiconductor ASA
#
# SPDX-License-Identifier: Apache-2.0
#

menuconfig SIMPLE_LED_NRFX
	bool "Simple led nrfx drivers"
	default y
	depends on SOC_FAMILY_NRF
	help
	  Enable support for imple led drivers for nRF MCU series.
```

## dts/bindings/arm/nordic,simple-led.yaml
```yaml
---
title: Nordic Simple Led
version: 0.1

description: >
    Binding for the Nordic Simple Led

properties:
    compatible:
      type: string
      category: required
      description: compatible strings
      constraint: "nordic,simple-led"
      generation: define

    pin:
      type: int
      category: required
      description: Pin number
      generation: define

    label:
      type: string
      category: required
      description: Human readable string describing the device (used by Zephyr for API name)
      generation: define
...
```
